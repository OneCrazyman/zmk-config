/ {
    behaviors {
        msl: msl {
            compatible = "zmk,behavior";
            bindings = <&kp LCTRL &kp KP_N4>;
        };
        msd: msd {
            compatible = "zmk,behavior";
            bindings = <&kp LCTRL &kp KP_N2>;
        };
    };
};